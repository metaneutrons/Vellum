## firmware-d1001-v6/sdkconfig.defaults
```kconfig
# Vellum D1001 — ESP32-P4 + ESP32-C6 (WiFi) on ESP-IDF v6.0
CONFIG_IDF_TARGET="esp32p4"
CONFIG_ESPTOOLPY_FLASHMODE_QIO=y
CONFIG_ESPTOOLPY_FLASHSIZE_16MB=y
CONFIG_PARTITION_TABLE_CUSTOM=y
CONFIG_COMPILER_OPTIMIZATION_PERF=y

# PSRAM (32MB)
CONFIG_SPIRAM=y
CONFIG_SPIRAM_SPEED_200M=y
CONFIG_SPIRAM_USE_MALLOC=y
CONFIG_SPIRAM_MALLOC_ALWAYSINTERNAL=8192
CONFIG_SPIRAM_MALLOC_RESERVE_INTERNAL=65536
CONFIG_SPIRAM_TRY_ALLOCATE_WIFI_LWIP=y

# Cache
CONFIG_CACHE_L2_CACHE_256KB=y
CONFIG_CACHE_L2_CACHE_LINE_128B=y

# FreeRTOS
CONFIG_FREERTOS_HZ=1000

# WiFi via ESP-Hosted (ESP32-C6 SDIO slave)
CONFIG_IDF_EXPERIMENTAL_FEATURES=y
CONFIG_SLAVE_IDF_TARGET_ESP32C6=y
CONFIG_ESP_HOSTED_USE_MEMPOOL=n
CONFIG_ESP_HOSTED_SDIO_GPIO_RESET_SLAVE=13
CONFIG_ESP_HOSTED_PRIV_SDIO_PIN_CLK_SLOT_1=11
CONFIG_ESP_HOSTED_PRIV_SDIO_PIN_CMD_SLOT_1=6
CONFIG_ESP_HOSTED_PRIV_SDIO_PIN_D0_SLOT_1=7
CONFIG_ESP_HOSTED_PRIV_SDIO_PIN_D1_4BIT_BUS_SLOT_1=8
CONFIG_ESP_HOSTED_PRIV_SDIO_PIN_D2_4BIT_BUS_SLOT_1=9
CONFIG_ESP_HOSTED_PRIV_SDIO_PIN_D3_4BIT_BUS_SLOT_1=10

# Console
CONFIG_ESP_CONSOLE_USB_SERIAL_JTAG=y

# LVGL
CONFIG_LV_MEM_CUSTOM=y
CONFIG_LV_MEMCPY_MEMSET_STD=y
CONFIG_LV_FONT_MONTSERRAT_16=y
CONFIG_LV_FONT_MONTSERRAT_24=y
CONFIG_LV_FONT_MONTSERRAT_32=y
CONFIG_LV_FONT_MONTSERRAT_48=y

# Chip revision (D1001 has v1.3)
CONFIG_ESP32P4_SELECTS_REV_LESS_V3=y
CONFIG_ESP32P4_REV_MIN_100=y
```

## firmware-d1001/components/esp_cam_sensor/sensors/bf2253/Kconfig.bf2253
```kconfig
menuconfig CAMERA_BF2253
    bool "BF2253"
    default n
    depends on SOC_MIPI_CSI_SUPPORTED
    help
        Enable support for the BF2253 CMOS image sensor.

if CAMERA_BF2253
    menu "Auto detect BF2253"
        config CAMERA_BF2253_AUTO_DETECT_MIPI_INTERFACE_SENSOR
            bool "Detect for MIPI CSI interface sensor"
            default y
            help
                When enabled, the BF2253 sensor will be automatically detected
                and initialized on the MIPI CSI interface at startup without requiring
                manual detection call(bf2253_detect) in your application.
    endmenu

    choice CAMERA_BF2253_MIPI_DEFAULT_FMT
        prompt "Select default output format for MIPI CSI interface"
        default CAMERA_BF2253_MIPI_RAW10_1600X1200_30FPS
        help
            This option allows you to select the default video format for the BF2253 sensor
            when it is initialized on the MIPI CSI interface. The selected format will be used
            when the sensor is detected and initialized, and can be changed later when the
            sensor is in stream off state.

        config CAMERA_BF2253_MIPI_RAW10_1600X1200_30FPS
            bool "RAW10 1600x1200 30fps, MIPI 1-lane, 24M input"
            help
                RAW10 color format at 1600x1200 resolution (UXGA) with 30fps framerate.
                Requires MIPI CSI-2 1-lane interface and 24MHz input clock.
        config CAMERA_BF2253_MIPI_RAW10_1280X720_30FPS
            bool "RAW10 1280x720 30fps, MIPI 1-lane, 24M input"
            help
                RAW10 color format at 1280x720 resolution (HD) with 30fps framerate.
                Requires MIPI CSI-2 1-lane interface and 24MHz input clock.
        config CAMERA_BF2253_MIPI_RAW8_800X1200_30FPS
            bool "RAW10 800x1200 30fps, MIPI 1-lane, 24M input"
            help
                RAW10 color format at 800x1200 resolution (HD) with 30fps framerate.
                Requires MIPI CSI-2 1-lane interface and 24MHz input clock.
        config CAMERA_BF2253_MIPI_RAW8_800X800_30FPS
            bool "RAW10 800x800 30fps, MIPI 1-lane, 24M input"
            help
                RAW10 color format at 800x800 resolution (HD) with 30fps framerate.
                Requires MIPI CSI-2 1-lane interface and 24MHz input clock.
    endchoice # CAMERA_BF2253_MIPI_CSI_DEFAULT_FMT

    config CAMERA_BF2253_MIPI_IF_FORMAT_INDEX_DEFAULT
        int
        default 0 if CAMERA_BF2253_MIPI_RAW10_1600X1200_30FPS
        default 1 if CAMERA_BF2253_MIPI_RAW10_1280X720_30FPS
        default 2 if CAMERA_BF2253_MIPI_RAW8_800X1200_30FPS
        default 3 if CAMERA_BF2253_MIPI_RAW8_800X800_30FPS
        help
            Sets the default configuration for the CSI interface.
            Use query_support_formats() API to get more format options.
    
    config CAMERA_BF2253_ABSOLUTE_GAIN_LIMIT
        int "Maximum absolute gain limit (x1000)"
        default 4000
        range 1024 10856
        help
            Set the maximum gain limit that can be applied by upper-level applications.

            Value is gain multiplied by 1000 to avoid floating-point arithmetic:
            - 1024 = 1.024x gain (minimum)
            - 10856 = 10.856x gain (maximum)

            Lower values reduce noise but may limit low-light performance.
            Higher values improve low-light sensitivity but increase noise and
            may cause sensor overheating.

            Recommended values:
            - 4000 (4x): Good balance for most applications
            -  (x): Enhanced low-light performance
            -  (x): Maximum sensitivity (use with caution)
endif
```

## firmware-d1001/main/Kconfig.projbuild
```kconfig
menu "Vellum D1001 Configuration"

    config VELLUM_SERVER_URL
        string "Vellum Server URL"
        default "http://vellum.local:3000"
        help
            URL of the Vellum server (without trailing slash).

endmenu
```

## firmware-d1001/sdkconfig.defaults
```kconfig
# Vellum D1001 — ESP32-P4 + ESP32-C6 (WiFi co-processor)
CONFIG_IDF_TARGET="esp32p4"

# Flash (32MB on D1001)
CONFIG_ESPTOOLPY_FLASHSIZE_16MB=y

# PSRAM (32MB)
CONFIG_SPIRAM=y
CONFIG_SPIRAM_MODE_OCT=y
CONFIG_SPIRAM_SPEED_200M=y

# WiFi via ESP32-C6 co-processor
CONFIG_ESP_WIFI_REMOTE_ENABLED=y

# HTTP client
CONFIG_ESP_HTTP_CLIENT_ENABLE_HTTPS=y

# Partition table
CONFIG_PARTITION_TABLE_CUSTOM=y
CONFIG_PARTITION_TABLE_CUSTOM_FILENAME="partitions.csv"

# Stack sizes
CONFIG_ESP_MAIN_TASK_STACK_SIZE=16384

# JPEG decoder (hardware accelerated on P4)
CONFIG_JPEG_ENABLE=y
```

## firmware/components/wifi_manager/Kconfig
```kconfig
menu "Vellum WiFi Manager"

    config VELLUM_PORTAL_IP
        string "Captive portal IP address"
        default "10.0.0.1"
        help
            IP address for the SoftAP captive portal.
            The device will use this as its AP gateway and HTTP server address.

endmenu
```
