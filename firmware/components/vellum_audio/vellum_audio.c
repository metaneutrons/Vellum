// SPDX-License-Identifier: AGPL-3.0-or-later
// Copyright (c) 2026 Fabian Schmieder. All rights reserved.
/**
 * @file vellum_audio.c
 * @brief D1001 confirmation chime over the ES8311 codec.
 *
 * Pin assignment is from Seeed's own reTerminal D1001 speaker documentation
 * (https://wiki.seeedstudio.com/driving_reterminal_d1001_speaker/), corroborated
 * where it overlaps this repo: the codec sits at 0x18 on the board's I2C bus 1
 * (SDA20/SCL21, `D1001_I2C1_*`), and the power amplifier enable is PCA9535 P13 —
 * port 1 bit 3, which is expander pin 11, the `D1001_EXP_AMP_EN` mask the board
 * header already defined.
 */
#include "vellum_audio.h"

#include "d1001_board.h"
#include "driver/i2s_std.h"
#include "esp_check.h"
#include "esp_codec_dev.h"
#include "esp_codec_dev_defaults.h"
#include "es8311_codec.h"
#include "freertos/FreeRTOS.h"
#include "freertos/task.h"

static const char *TAG = "vellum_audio";

/* I2S wiring. DIN is deliberately left unconnected: Seeed documents the
 * microphone input on GPIO11, which on this firmware is the ESP32-C6's SDIO clock
 * (`D1001_WIFI_SDIO_CLK`). Claiming it for I2S would take out Wi-Fi. Playback
 * needs DOUT only — adding microphone capture here means resolving that conflict
 * first, not just filling in the pin. */
#define AUDIO_I2S_MCLK  GPIO_NUM_33
#define AUDIO_I2S_BCLK  GPIO_NUM_32
#define AUDIO_I2S_WS    GPIO_NUM_31
#define AUDIO_I2S_DOUT  GPIO_NUM_30

/** Playback volume, percent. The chime is peak-normalised to -1 dBFS, so this is
 *  the only place loudness is decided. Feedback should be audible across a room
 *  without being startling next to the panel. */
#define AUDIO_VOLUME_PCT 70

/* Generated by assets/render-audio.sh — see chime_pcm.c. */
extern const int16_t vellum_chime_pcm[];
extern const uint32_t vellum_chime_sample_count;
extern const uint32_t vellum_chime_sample_rate;

static esp_codec_dev_handle_t s_codec;
static i2s_chan_handle_t s_tx;
static bool s_init_attempted;

esp_err_t vellum_audio_init(void)
{
    if (s_codec) return ESP_OK;
    /* One attempt per boot. A board whose codec does not answer must not retry the
     * whole bring-up on every button press. */
    if (s_init_attempted) return ESP_ERR_INVALID_STATE;

    /* Being called too early is not a codec failure, so it must not consume the
     * single attempt: latching here would make the device permanently silent if a
     * beep were ever moved ahead of d1001_board_init(). */
    i2c_master_bus_handle_t bus = d1001_i2c1_handle();
    ESP_RETURN_ON_FALSE(bus, ESP_ERR_INVALID_STATE, TAG,
                        "I2C bus 1 not ready — call d1001_board_init() first");

    s_init_attempted = true;

    i2s_chan_config_t chan_cfg = I2S_CHANNEL_DEFAULT_CONFIG(I2S_NUM_AUTO, I2S_ROLE_MASTER);
    ESP_RETURN_ON_ERROR(i2s_new_channel(&chan_cfg, &s_tx, NULL), TAG, "i2s_new_channel");

    i2s_std_config_t std_cfg = {
        .clk_cfg = I2S_STD_CLK_DEFAULT_CONFIG(vellum_chime_sample_rate),
        /* Mono source into a mono codec. The slot stays stereo-framed (Philips)
         * because that is what the ES8311 expects; the driver duplicates the
         * single channel. */
        .slot_cfg = I2S_STD_PHILIPS_SLOT_DEFAULT_CONFIG(I2S_DATA_BIT_WIDTH_16BIT,
                                                        I2S_SLOT_MODE_MONO),
        .gpio_cfg = {
            .mclk = AUDIO_I2S_MCLK,
            .bclk = AUDIO_I2S_BCLK,
            .ws   = AUDIO_I2S_WS,
            .dout = AUDIO_I2S_DOUT,
            .din  = I2S_GPIO_UNUSED,
            .invert_flags = { false, false, false },
        },
    };
    ESP_RETURN_ON_ERROR(i2s_channel_init_std_mode(s_tx, &std_cfg), TAG, "i2s std mode");

    audio_codec_i2s_cfg_t i2s_cfg = { .tx_handle = s_tx };
    const audio_codec_data_if_t *data_if = audio_codec_new_i2s_data(&i2s_cfg);
    ESP_RETURN_ON_FALSE(data_if, ESP_FAIL, TAG, "i2s data interface");

    audio_codec_i2c_cfg_t i2c_cfg = {
        .addr = ES8311_CODEC_DEFAULT_ADDR,   /* 0x30 == 0x18 << 1 */
        .bus_handle = bus,
    };
    const audio_codec_ctrl_if_t *ctrl_if = audio_codec_new_i2c_ctrl(&i2c_cfg);
    ESP_RETURN_ON_FALSE(ctrl_if, ESP_FAIL, TAG, "i2c control interface");

    es8311_codec_cfg_t es_cfg = {
        .ctrl_if = ctrl_if,
        .codec_mode = ESP_CODEC_DEV_WORK_MODE_DAC,
        /* The amplifier hangs off the IO expander, not a GPIO, so the codec driver
         * cannot gate it — this file does, around each chime. */
        .pa_pin = -1,
        .master_mode = true,   /* the P4 generates BCLK/WS */
        .use_mclk = true,
    };
    const audio_codec_if_t *codec_if = es8311_codec_new(&es_cfg);
    ESP_RETURN_ON_FALSE(codec_if, ESP_FAIL, TAG, "ES8311 not responding at 0x18");

    esp_codec_dev_cfg_t dev_cfg = {
        .dev_type = ESP_CODEC_DEV_TYPE_OUT,
        .codec_if = codec_if,
        .data_if = data_if,
    };
    s_codec = esp_codec_dev_new(&dev_cfg);
    ESP_RETURN_ON_FALSE(s_codec, ESP_FAIL, TAG, "codec device");

    esp_codec_dev_set_out_vol(s_codec, AUDIO_VOLUME_PCT);
    ESP_LOGI(TAG, "ES8311 ready (%" PRIu32 " Hz mono)", vellum_chime_sample_rate);
    return ESP_OK;
}

bool vellum_audio_available(void)
{
    return s_codec != NULL;
}

static void amplifier(bool on)
{
    esp_io_expander_handle_t exp = d1001_io_expander();
    if (exp) esp_io_expander_set_level(exp, D1001_EXP_AMP_EN, on ? 1 : 0);
}

void vellum_audio_play_chime(void)
{
    if (!s_codec && vellum_audio_init() != ESP_OK) {
        /* Feedback is not worth failing a render over; the caller carries on. */
        return;
    }

    esp_codec_dev_sample_info_t fs = {
        .bits_per_sample = 16,
        .channel = 1,
        .sample_rate = vellum_chime_sample_rate,
    };
    if (esp_codec_dev_open(s_codec, &fs) != ESP_CODEC_DEV_OK) {
        ESP_LOGW(TAG, "codec open failed — skipping chime");
        return;
    }

    /* Amplifier on only while sound is playing: a 2 W class-D amp left enabled
     * idles audibly and costs current on a battery-powered panel. */
    amplifier(true);
    int bytes = (int)(vellum_chime_sample_count * sizeof(vellum_chime_pcm[0]));
    int written = esp_codec_dev_write(s_codec, (void *)vellum_chime_pcm, bytes);
    if (written != bytes) {
        ESP_LOGW(TAG, "short write: %d of %d bytes", written, bytes);
    }
    /* The I2S DMA queue drains after the write returns; muting immediately clips
     * the tail of the chime. */
    vTaskDelay(pdMS_TO_TICKS(40));
    amplifier(false);

    esp_codec_dev_close(s_codec);
}
