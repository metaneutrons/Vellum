## firmware/components/http_client/Kconfig
```kconfig
menu "Vellum HTTP client"

    config VELLUM_ALLOW_INSECURE_PRIVATE_HTTP
        bool "Allow plaintext HTTP to private IPv4 addresses (development only)"
        default n
        help
            Permit backend requests to RFC1918 IPv4 literals over http://.
            This is intended only for a locally flashed development device.
            Credentials, device tokens, telemetry, and display content can be
            observed or modified by anyone on the local network. Production and
            release builds must leave this disabled; HTTPS remains mandatory for
            hostnames, public addresses, and all OTA downloads.

endmenu
```

## firmware/sdkconfig.defaults.p4
```kconfig
# Vellum Firmware — ESP32-P4 (LCD: D1001)
CONFIG_IDF_TARGET="esp32p4"

# Flash
CONFIG_ESPTOOLPY_FLASHMODE_QIO=y
CONFIG_ESPTOOLPY_FLASHSIZE_16MB=y
CONFIG_PARTITION_TABLE_CUSTOM=y
CONFIG_PARTITION_TABLE_CUSTOM_FILENAME="partitions.csv"
CONFIG_COMPILER_OPTIMIZATION_PERF=y

# Panel
CONFIG_VELLUM_PANEL_D1001=y

# Chip revision (D1001 has v1.3)
CONFIG_ESP32P4_SELECTS_REV_LESS_V3=y
CONFIG_ESP32P4_REV_MIN_100=y

# PSRAM (32MB)
CONFIG_SPIRAM=y
CONFIG_SPIRAM_SPEED_200M=y
CONFIG_SPIRAM_USE_MALLOC=y
CONFIG_SPIRAM_MALLOC_ALWAYSINTERNAL=8192
CONFIG_SPIRAM_MALLOC_RESERVE_INTERNAL=65536
CONFIG_SPIRAM_TRY_ALLOCATE_WIFI_LWIP=y

# Cache
CONFIG_CACHE_L2_CACHE_256KB=y
CONFIG_CACHE_L2_CACHE_LINE_128B=y

# FreeRTOS
CONFIG_FREERTOS_HZ=1000

# WiFi via ESP-Hosted (ESP32-C6 SDIO slave)
CONFIG_IDF_EXPERIMENTAL_FEATURES=y
CONFIG_SLAVE_IDF_TARGET_ESP32C6=y
CONFIG_ESP_HOSTED_USE_MEMPOOL=n
CONFIG_ESP_HOSTED_SDIO_GPIO_RESET_SLAVE=13
CONFIG_ESP_HOSTED_PRIV_SDIO_PIN_CLK_SLOT_1=11
CONFIG_ESP_HOSTED_PRIV_SDIO_PIN_CMD_SLOT_1=6
CONFIG_ESP_HOSTED_PRIV_SDIO_PIN_D0_SLOT_1=7
CONFIG_ESP_HOSTED_PRIV_SDIO_PIN_D1_4BIT_BUS_SLOT_1=8
CONFIG_ESP_HOSTED_PRIV_SDIO_PIN_D2_4BIT_BUS_SLOT_1=9
CONFIG_ESP_HOSTED_PRIV_SDIO_PIN_D3_4BIT_BUS_SLOT_1=10

# Console
CONFIG_ESP_CONSOLE_USB_SERIAL_JTAG=y

# LVGL
CONFIG_LV_MEM_CUSTOM=y
CONFIG_LV_MEMCPY_MEMSET_STD=y
CONFIG_LV_FONT_MONTSERRAT_16=y
CONFIG_LV_FONT_MONTSERRAT_24=y
CONFIG_LV_FONT_MONTSERRAT_32=y
CONFIG_LV_FONT_MONTSERRAT_48=y

# Logging
CONFIG_LOG_DEFAULT_LEVEL_INFO=y
CONFIG_LOG_MAXIMUM_LEVEL_DEBUG=y

# Watchdog
CONFIG_ESP_TASK_WDT_TIMEOUT_S=30

# Main task
CONFIG_ESP_MAIN_TASK_STACK_SIZE=16384

# Wi-Fi SoftAP (for provisioning)
CONFIG_ESP_WIFI_SOFTAP_SUPPORT=y

# HTTP
CONFIG_HTTPD_MAX_REQ_HDR_LEN=1024
CONFIG_HTTPD_MAX_URI_LEN=512

# OTA rollback (see ota_manager_mark_valid)
CONFIG_BOOTLOADER_APP_ROLLBACK_ENABLE=y
```
